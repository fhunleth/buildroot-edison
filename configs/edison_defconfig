## configs/edison_defconfig
```kconfig
BR2_x86_core2=y
BR2_TOOLCHAIN_EXTERNAL=y
BR2_TARGET_GENERIC_GETTY_PORT="ttyMFD2"
BR2_ROOTFS_POST_IMAGE_SCRIPT="board/edison/mkedison.sh"
BR2_LINUX_KERNEL=y
BR2_LINUX_KERNEL_CUSTOM_VERSION=y
BR2_LINUX_KERNEL_CUSTOM_VERSION_VALUE="3.10.17"
BR2_LINUX_KERNEL_PATCH="board/edison/linux-3.10"
BR2_LINUX_KERNEL_USE_CUSTOM_CONFIG=y
BR2_LINUX_KERNEL_CUSTOM_CONFIG_FILE="board/edison/linux-3.10.defconfig"
BR2_LINUX_KERNEL_INSTALL_TARGET=y
BR2_PACKAGE_BUSYBOX_WATCHDOG=y
BR2_TARGET_ROOTFS_EXT2=y
BR2_TARGET_ROOTFS_EXT2_4=y
BR2_TARGET_ROOTFS_EXT2_LABEL="rootfs"
# BR2_TARGET_ROOTFS_TAR is not set
BR2_TARGET_UBOOT=y
BR2_TARGET_UBOOT_BOARDNAME="edison"
BR2_TARGET_UBOOT_CUSTOM_VERSION=y
BR2_TARGET_UBOOT_CUSTOM_VERSION_VALUE="2014.04"
BR2_TARGET_UBOOT_CUSTOM_PATCH_DIR="board/edison/u-boot"
BR2_TARGET_UBOOT_ENVIMAGE=y
BR2_TARGET_UBOOT_ENVIMAGE_SOURCE="board/edison/u-boot.env"
BR2_TARGET_UBOOT_ENVIMAGE_SIZE="65536"
BR2_TARGET_UBOOT_ENVIMAGE_REDUNDANT=y
BR2_PACKAGE_HOST_DFU_UTIL=y
```

## package/erlang-jiffy/Config.in
```kconfig
config BR2_PACKAGE_ERLANG_JIFFY
	bool "erlang-jiffy"
	help
	  JSON NIFs for Erlang

	  https://github.com/davisp/jiffy
```

## package/erlang-luerl/Config.in
```kconfig
config BR2_PACKAGE_ERLANG_LUERL
	bool "erlang-luerl"
	help
	  Lua in Erlang

	  https://github.com/rvirding/luerl
```

## package/erlang-p1-fast-tls/Config.in
```kconfig
config BR2_PACKAGE_ERLANG_P1_FAST_TLS
	bool "erlang-p1-fast-tls"
	select BR2_PACKAGE_OPENSSL
	select BR2_PACKAGE_ERLANG_P1_UTILS
	help
	  TLS / SSL OpenSSL-based native driver for Erlang / Elixir

	  https://github.com/processone/fast_tls
```

## package/erlang-p1-fast-xml/Config.in
```kconfig
config BR2_PACKAGE_ERLANG_P1_FAST_XML
	bool "erlang-p1-fast-xml"
	select BR2_PACKAGE_ERLANG_P1_UTILS
	select BR2_PACKAGE_EXPAT
	help
	  Fast Expat based Erlang XML parsing library

	  https://github.com/processone/fast_xml
```

## package/erlang-p1-fast-yaml/Config.in
```kconfig
config BR2_PACKAGE_ERLANG_P1_FAST_YAML
	bool "erlang-p1-fast-yaml"
	select BR2_PACKAGE_ERLANG_P1_UTILS
	select BR2_PACKAGE_LIBYAML
	help
	  Fast YAML native library for Erlang / Elixir

	  https://github.com/processone/fast_yaml
```

## package/erlang-p1-oauth2/Config.in
```kconfig
config BR2_PACKAGE_ERLANG_P1_OAUTH2
	bool "erlang-p1-oauth2"
	help
	  Erlang Oauth2 implementation

	  https://github.com/processone/p1_oauth2
```

## package/rust/Config.in.host
```kconfig
config BR2_PACKAGE_HOST_RUST_ARCH_SUPPORTS
	bool
	default y
	depends on BR2_HOSTARCH = "x86_64" || BR2_HOSTARCH = "x86"
	depends on BR2_arm  || BR2_aarch64 || BR2_i386 \
		|| BR2_mips || BR2_mipsel  || BR2_x86_64
	depends on !BR2_ARM_CPU_ARMV4 && !BR2_ARM_CPU_ARMV5
	depends on BR2_TOOLCHAIN_USES_GLIBC
	depends on BR2_HOST_GCC_AT_LEAST_4_7 # required by LLVM
	# triggers ICE on trunc_int_for_mode, at explow.c:56
	depends on BR2_TOOLCHAIN_GCC_AT_LEAST_5 || !BR2_aarch64

comment "host-rust needs a toolchain w/ gcc >= 5"
	depends on !BR2_TOOLCHAIN_GCC_AT_LEAST_5 && BR2_aarch64
```
